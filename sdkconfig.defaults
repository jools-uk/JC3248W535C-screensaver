## sdkconfig.defaults
```kconfig
# Flash: 16 MB QIO 80 MHz
CONFIG_ESPTOOLPY_FLASHSIZE_16MB=y
CONFIG_ESPTOOLPY_FLASHSIZE="16MB"
CONFIG_ESPTOOLPY_FLASHMODE_QIO=y
CONFIG_ESPTOOLPY_FLASHFREQ_80M=y

# PSRAM: OPI 8 MB (ESP32-S3-WROOM-1)
CONFIG_SPIRAM=y
CONFIG_SPIRAM_MODE_OCT=y
CONFIG_SPIRAM_SPEED_80M=y
CONFIG_SPIRAM_FETCH_INSTRUCTIONS=y
CONFIG_SPIRAM_RODATA=y

# CPU 240 MHz
CONFIG_ESP32S3_DEFAULT_CPU_FREQ_MHZ=240

# Stacks
CONFIG_ESP_MAIN_TASK_STACK_SIZE=8192

# FreeRTOS 1 kHz tick for 1 ms delays
CONFIG_FREERTOS_HZ=1000

# Performance optimisation
CONFIG_COMPILER_OPTIMIZATION_PERF=y

# Full newlib float support (printf %f etc.)
CONFIG_NEWLIB_NANO_FORMAT=n
```
